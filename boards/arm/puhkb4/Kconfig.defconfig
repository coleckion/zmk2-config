## boards/arm/puhkb4/Kconfig.puhkb4
```kconfig
config BOARD_PUHKB4
    select SOC_NRF52840_QIAA
    imply RETAINED_MEM if BOARD_PUHKB4_NRF52840_ZMK
    imply RETENTION if BOARD_PUHKB4_NRF52840_ZMK
    imply RETENTION_BOOT_MODE if BOARD_PUHKB4_NRF52840_ZMK
```

## boards/arm/puhkb4/board.yml
```yaml
board:
  name: puhkb4
   revision:
    format: <major.minor.patch>
    default: "1.0.0"
    revisions:
    - name: "1.0.0"
  socs:
  - name: nrf52840
    variants:
    - name: zmk
```

## module/boards/arm/puhkb4/board.yml
```yaml
board:
  name: puhkb4
  vendor: coleckion
  socs:
    - name: nrf52840
  revision:
    format: major.minor.patch
    default: 1.0.0
    revisions:
      - name: 1.0.0
```
