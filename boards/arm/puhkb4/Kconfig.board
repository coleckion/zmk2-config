## boards/arm/puhkb4/Kconfig.board
```kconfig
# nrfmicro board configuration

# Copyright (c) 2020 The ZMK Contributors
# SPDX-License-Identifier: MIT

config BOARD_PUHKB4
    bool "puhkb4"
    depends on SOC_NRF52840_QIAA
```

## boards/arm/test2/Kconfig.board
```kconfig
config BOARD_TEST2_LEFT
    bool "test2 left"
    depends on SOC_NRF52840_QIAA

config BOARD_TEST2_RIGHT
    bool "test2 right"
    depends on SOC_NRF52840_QIAA
```

## boards/shields/puhkb4dongle/Kconfig.defconfig
```kconfig
# Copyright (c) 2020 Ryan Cross
# SPDX-License-Identifier: MIT

if SHIELD_PUHKB4DONGLE_CENTER
	config ZMK_KEYBOARD_NAME
		default "PUHKB4DONGLE"
	config ZMK_SPLIT
		default y
	config ZMK_SPLIT_ROLE_CENTRAL
		default y
	config ZMK_RGB_UNDERGLOW
		select WS2812_STRIP
		select SPI
	if ZMK_DISPLAY
		config SSD1306
			default y
		config I2C
			default y
	endif # ZMK_DISPLAY
	if LVGL
		config LV_Z_VDB_SIZE
			default 64
		config LV_DPI_DEF
			default 148
		config LV_Z_BITS_PER_PIXEL
			default 1
		choice LV_COLOR_DEPTH
			default LV_COLOR_DEPTH_1
		endchoice
	endif # LVGL
endif

if SHIELD_PUHKB4DONGLE_LEFT || SHIELD_PUHKB4DONGLE_RIGHT
	config ZMK_SPLIT
		default y	
	config ZMK_RGB_UNDERGLOW
		select WS2812_STRIP
		select SPI
endif
```

## boards/shields/puhkb4dongle/Kconfig.shield
```kconfig
# Copyright (c) 2020 Ryan Cross
# SPDX-License-Identifier: MIT

config SHIELD_PUHKB4DONGLE_CENTER
    def_bool $(shields_list_contains,puhkb4dongle_center)
	
config SHIELD_PUHKB4DONGLE_LEFT
    def_bool $(shields_list_contains,puhkb4dongle_left)

config SHIELD_PUHKB4DONGLE_RIGHT
    def_bool $(shields_list_contains,puhkb4dongle_right)
```

## boards/shields/test1/Kconfig.defconfig
```kconfig
if SHIELD_TEST1_LEFT

config ZMK_KEYBOARD_NAME
    default "test"

config ZMK_SPLIT_ROLE_CENTRAL
    default y

endif # SHIELD_TEST1_LEFT

if SHIELD_TEST1_LEFT || SHIELD_TEST1_RIGHT

config ZMK_SPLIT
    default y

endif # SHIELD_TEST1_LEFT || SHIELD_TEST1_RIGHT
```

## boards/shields/test1/Kconfig.shield
```kconfig
config SHIELD_TEST1_LEFT
    def_bool $(shields_list_contains,test1_left)

config SHIELD_TEST1_RIGHT
    def_bool $(shields_list_contains,test1_right)
```
